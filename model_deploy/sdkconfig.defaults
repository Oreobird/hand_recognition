## model_deploy/sdkconfig.defaults
```kconfig
CONFIG_ESPTOOLPY_FLASHSIZE_4MB=y

CONFIG_ESPTOOLPY_FLASHFREQ_80M=y
CONFIG_ESPTOOLPY_FLASHMODE_QIO=y

CONFIG_SPIRAM_SPEED_80M=y

CONFIG_PARTITION_TABLE_CUSTOM=y
CONFIG_PARTITION_TABLE_CUSTOM_FILENAME="partitions.csv"

CONFIG_ESP_WIFI_SOFTAP_SUPPORT=

CONFIG_OV7670_SUPPORT=
CONFIG_OV7725_SUPPORT=
CONFIG_NT99141_SUPPORT=
CONFIG_OV2640_SUPPORT=y
CONFIG_OV3660_SUPPORT=
CONFIG_OV5640_SUPPORT=
CONFIG_GC2145_SUPPORT=
CONFIG_GC032A_SUPPORT=
CONFIG_GC0308_SUPPORT=
CONFIG_BF3005_SUPPORT=
CONFIG_BF20A6_SUPPORT=
CONFIG_SC101IOT_SUPPORT=
CONFIG_SC030IOT_SUPPORT=
CONFIG_SCCB_HARDWARE_I2C_PORT1=y
CONFIG_SCCB_CLK_FREQ=10000000
CONFIG_CAMERA_TASK_STACK_SIZE=2048
CONFIG_CAMERA_CORE1=y
CONFIG_CAMERA_DMA_BUFFER_SIZE_MAX=32768

CONFIG_TASK_WDT_TIMEOUT_S=15
```
